## drivers/misc/timed_task/Kconfig
```kconfig
config TIMED_TASK
    tristate "Timed Task Kernel Module"
    default n
    help
      This is a simple kernel module for testing timers with periodic or one-shot modes.
```

## drivers/misc/timed_task2/Kconfig
```kconfig
config TIMED_TASK2
    tristate "Timed Task2 Kernel Module"
    default n
    help
      This is a simple kernel module for testing timers with periodic or one-shot modes.
```
